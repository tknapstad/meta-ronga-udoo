## conf/layer.conf
```bitbake
# We have a conf and classes directory, add to BBPATH
BBPATH .= ":${LAYERDIR}"

# We have a packages directory, add to BBFILES
BBFILES += "${LAYERDIR}/recipes-*/*/*.bb \
            ${LAYERDIR}/recipes-*/*/*.bbappend"

BBFILE_COLLECTIONS += "norbit-seco"
BBFILE_PATTERN_norbit-seco := "^${LAYERDIR}/"
BBFILE_PRIORITY_norbit-seco = "4"
```

## conf/machine/secosbc-a62-quad.conf
```bitbake
#@TYPE: Machine
#@NAME: SECOSBC-A62 Quad
#@SOC: i.MX6Q
#@DESCRIPTION: Machine configuration for SECOSBC-A62 Quad

include conf/machine/include/imx-base.inc
include conf/machine/include/tune-cortexa9.inc

SOC_FAMILY = "mx6:mx6q"

PREFERRED_PROVIDER_virtual/kernel ?= "linux-seco"

PREFERRED_PROVIDER_u-boot = "u-boot-seco"

PREFERRED_PROVIDER_virtual/bootloader ?= "u-boot"

UBOOT_MACHINE = "mx6q_seco_config"

#KERNEL_DEVICETREE = "imx6q-seco.dtb"

SERIAL_CONSOLE = "115200 ttymxc1"

#MACHINE_FEATURES += ""
```
